/dts-v1/;
/plugin/;

// compile with `dtc -@ -I dts -O dtb -o mipi-panel.dtbo <PANEL>.dtso`

/ {
  fragment@0 {
    target-path = "/dsi@ff450000/panel@0";
    __overlay__ {
      compatible = "rocknix,generic-dsi";
      panel_description =
        "G size=52,70 format=rgb888 lanes=4 flags=0xe03",

        "M clock=27500 horizontal=640,50,2,90 vertical=480,18,2,86",

        "I dcs=ff data=30",
        "I dcs=ff data=52",
        "I dcs=ff data=01",

        "I dcs=e3 data=00",
        "I dcs=40 data=0a",
        "I dcs=03 data=40",
        "I dcs=04 data=00",
        "I dcs=05 data=03",
        "I dcs=24 data=12",
        "I dcs=25 data=1e",
        "I dcs=26 data=28",
        "I dcs=27 data=52",
        "I dcs=28 data=57",
        "I dcs=29 data=01",
        "I dcs=2a data=df",
        "I dcs=38 data=9c",
        "I dcs=39 data=a7",
        "I dcs=3a data=53",
        "I dcs=44 data=00",
        "I dcs=49 data=3c",
        "I dcs=59 data=fe",
        "I dcs=5c data=00",
        "I dcs=91 data=77",
        "I dcs=92 data=77",
        "I dcs=a0 data=55",
        "I dcs=a1 data=50",
        "I dcs=a4 data=9c",
        "I dcs=a7 data=02",
        "I dcs=a8 data=01",
        "I dcs=a9 data=01",
        "I dcs=aa data=fc",
        "I dcs=ab data=28",
        "I dcs=ac data=06",
        "I dcs=ad data=06",
        "I dcs=ae data=06",
        "I dcs=af data=03",
        "I dcs=b0 data=08",
        "I dcs=b1 data=26",
        "I dcs=b2 data=28",
        "I dcs=b3 data=28",
        "I dcs=b4 data=33",
        "I dcs=b5 data=08",
        "I dcs=b6 data=26",
        "I dcs=b7 data=08",
        "I dcs=b8 data=26",

        "I dcs=ff data=30",
        "I dcs=ff data=52",
        "I dcs=ff data=02",

        "I dcs=b0 data=0b",
        "I dcs=b1 data=16",
        "I dcs=b2 data=17",
        "I dcs=b3 data=2c",
        "I dcs=b4 data=32",
        "I dcs=b5 data=3b",
        "I dcs=b6 data=29",
        "I dcs=b7 data=40",
        "I dcs=b8 data=0d",
        "I dcs=b9 data=05",
        "I dcs=ba data=12",
        "I dcs=bb data=10",
        "I dcs=bc data=12",
        "I dcs=bd data=15",
        "I dcs=be data=19",
        "I dcs=bf data=0e",
        "I dcs=c0 data=16",
        "I dcs=c1 data=0a",
        "I dcs=d0 data=0c",
        "I dcs=d1 data=17",
        "I dcs=d2 data=14",
        "I dcs=d3 data=2e",
        "I dcs=d4 data=32",
        "I dcs=d5 data=3c",
        "I dcs=d6 data=22",
        "I dcs=d7 data=3d",
        "I dcs=d8 data=0d",
        "I dcs=d9 data=07",
        "I dcs=da data=13",
        "I dcs=db data=13",
        "I dcs=dc data=11",
        "I dcs=dd data=15",
        "I dcs=de data=19",
        "I dcs=df data=10",
        "I dcs=e0 data=17",
        "I dcs=e1 data=0a",

        "I dcs=ff data=30",
        "I dcs=ff data=52",
        "I dcs=ff data=03",

        "I dcs=00 data=2a",
        "I dcs=01 data=2a",
        "I dcs=02 data=2a",
        "I dcs=03 data=2a",
        "I dcs=04 data=61",
        "I dcs=05 data=80",
        "I dcs=06 data=c7",
        "I dcs=07 data=01",
        "I dcs=08 data=82",
        "I dcs=09 data=83",
        "I dcs=30 data=2a",
        "I dcs=31 data=2a",
        "I dcs=32 data=2a",
        "I dcs=33 data=2a",
        "I dcs=34 data=61",
        "I dcs=35 data=c5",
        "I dcs=36 data=80",
        "I dcs=37 data=23",
        "I dcs=40 data=82",
        "I dcs=41 data=83",
        "I dcs=42 data=80",
        "I dcs=43 data=81",
        "I dcs=44 data=11",
        "I dcs=45 data=f2",
        "I dcs=46 data=f1",
        "I dcs=47 data=11",
        "I dcs=48 data=f4",
        "I dcs=49 data=f3",
        "I dcs=50 data=02",
        "I dcs=51 data=01",
        "I dcs=52 data=04",
        "I dcs=53 data=03",
        "I dcs=54 data=11",
        "I dcs=55 data=f6",
        "I dcs=56 data=f5",
        "I dcs=57 data=11",
        "I dcs=58 data=f8",
        "I dcs=59 data=f7",
        "I dcs=7e data=02",
        "I dcs=7f data=80",
        "I dcs=e0 data=5a",
        "I dcs=b1 data=00",
        "I dcs=b4 data=0e",
        "I dcs=b5 data=0f",
        "I dcs=b6 data=04",
        "I dcs=b7 data=07",
        "I dcs=b8 data=06",
        "I dcs=b9 data=05",
        "I dcs=ba data=0f",
        "I dcs=c7 data=00",
        "I dcs=ca data=0e",
        "I dcs=cb data=0f",
        "I dcs=cc data=04",
        "I dcs=cd data=07",
        "I dcs=ce data=06",
        "I dcs=cf data=05",
        "I dcs=d0 data=0f",
        "I dcs=81 data=0f",
        "I dcs=84 data=0e",
        "I dcs=85 data=0f",
        "I dcs=86 data=07",
        "I dcs=87 data=04",
        "I dcs=88 data=05",
        "I dcs=89 data=06",
        "I dcs=8a data=00",
        "I dcs=97 data=0f",
        "I dcs=9a data=0e",
        "I dcs=9b data=0f",
        "I dcs=9c data=07",
        "I dcs=9d data=04",
        "I dcs=9e data=05",
        "I dcs=9f data=06",
        "I dcs=a0 data=00",

        "I dcs=ff data=30",
        "I dcs=ff data=52",
        "I dcs=ff data=02",

        "I dcs=01 data=01",
        "I dcs=02 data=da",
        "I dcs=03 data=ba",
        "I dcs=04 data=a8",
        "I dcs=05 data=9a",
        "I dcs=06 data=70",
        "I dcs=07 data=ff",
        "I dcs=08 data=91",
        "I dcs=09 data=90",
        "I dcs=0a data=ff",
        "I dcs=0b data=8f",
        "I dcs=0c data=60",
        "I dcs=0d data=58",
        "I dcs=0e data=48",
        "I dcs=0f data=38",
        "I dcs=10 data=2b",

        "I dcs=ff data=30",
        "I dcs=ff data=52",
        "I dcs=ff data=00",

        "I dcs=36 data=02",
        "I dcs=3a data=70",
        "#END";
    };
  };
};
